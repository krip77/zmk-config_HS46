## config/Kconfig.defconfig
```kconfig
config ZMK_KEYBOARD_NAME
    default "alixw"

if ZMK_DISPLAY

config I2C
	default y

config SSD1306
	default y

config SSD1306_REVERSE_MODE
	default y
```

## config/Kconfig.shield
```kconfig
config SHIELD_ALIXW
    def_bool $(shields_list_contains,hillside46)

# NOTE: Display configuration for hillside46 is now handled in:
# - config/boards/shields/hillside46/Kconfig.defconfig (Kconfig settings)
# - config/boards/shields/hillside46/hillside46_left.overlay (device tree)
# This root-level configuration is kept for backward compatibility but may conflict.
# If you have display issues, ensure hillside46_left.overlay is being used correctly.
```

## config/boards/shields/hillside46/Kconfig.defconfig
```kconfig
# Copyright (c) 2021-2022 The ZMK Contributors
# SPDX-License-Identifier: MIT

if SHIELD_HILLSIDE46_LEFT

config ZMK_KEYBOARD_NAME
    default "Hillside46"

config ZMK_SPLIT_BLE_ROLE_CENTRAL
    default y

CONFIG_PINCTRL=y

# Display configuration - only for left side (central role)
CONFIG_DISPLAY=y
CONFIG_SSD1306=y
CONFIG_ZMK_DISPLAY=y
CONFIG_ZMK_DISPLAY_INVERT=n
CONFIG_ZMK_WIDGET_LAYER_STATUS=y
CONFIG_ZMK_WIDGET_BATTERY_STATUS=y
CONFIG_ZMK_WIDGET_BATTERY_STATUS_SHOW_PERCENTAGE=y
CONFIG_ZMK_WIDGET_OUTPUT_STATUS=y
CONFIG_ZMK_WIDGET_WPM_STATUS=n
CONFIG_ZMK_DISPLAY_BLANK_ON_IDLE=n
CONFIG_ZMK_DISPLAY_STATUS_SCREEN_BUILT_IN=y
CONFIG_ZMK_DISPLAY_STATUS_SCREEN_CUSTOM=n
CONFIG_ZMK_DISPLAY_WORK_QUEUE_SYSTEM=y
CONFIG_ZMK_DISPLAY_WORK_QUEUE_DEDICATED=n

endif



if SHIELD_HILLSIDE46_LEFT || SHIELD_HILLSIDE46_RIGHT

config ZMK_SPLIT
    default y

endif
```
